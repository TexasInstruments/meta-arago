## meta-arago-demos/conf/layer.conf
```bitbake
# We have a conf and classes directory, append to BBPATH
BBPATH .= ":${LAYERDIR}"

# We have a recipes directory, add to BBFILES
BBFILES += "${LAYERDIR}/recipes*/*/*.bb ${LAYERDIR}/recipes*/*/*.bbappend"

BBFILE_COLLECTIONS += "meta-arago-demos"
BBFILE_PATTERN_meta-arago-demos := "^${LAYERDIR}/"
BBFILE_PRIORITY_meta-arago-demos = "10"

LAYERSERIES_COMPAT_meta-arago-demos = "scarthgap styhead walnascar"

LAYERDEPENDS_meta-arago-demos = " \
    core \
    meta-ti-bsp \
    meta-ti-extras \
    openembedded-layer \
    networking-layer \
    meta-python \
    arm-toolchain \
    qt5-layer \
"

SIGGEN_EXCLUDERECIPES_ABISAFE += " \
    gstreamer1.0-plugins-bad \
"
```

## meta-arago-distro/conf/distro/arago.conf
```bitbake
# Name and version of the distribution
DISTRO_NAME = "Arago"
DISTRO_VERSION = "2025.01"
DISTRO_FEED_URI ?= "http://lcpd.itg.ti.com"
BUILD_VARIANT = "${@['prod','rt'][int(d.getVar('ARAGO_RT_ENABLE'))]}"
TISDK_VERSION ?= "live"
FEEDURIPREFIX ?= "builds/${DISTRO}-master/${BUILD_VARIANT}/${MACHINE}/latest/packages/"

require conf/distro/include/yocto-space-optimize.inc

OPKG_ARGS:remove = "--prefer-arch-to-version"

TI_MIRROR = "http://software-dl.ti.com/processor-sdk-mirror/sources/"
MIRRORS += " \
bzr://.*/.*      ${TI_MIRROR} \n \
cvs://.*/.*      ${TI_MIRROR} \n \
git://.*/.*      ${TI_MIRROR} \n \
gitsm://.*/.*    ${TI_MIRROR} \n \
hg://.*/.*       ${TI_MIRROR} \n \
osc://.*/.*      ${TI_MIRROR} \n \
p4://.*/.*       ${TI_MIRROR} \n \
npm://.*/.*      ${TI_MIRROR} \n \
ftp://.*/.*      ${TI_MIRROR} \n \
https?$://.*/.*  ${TI_MIRROR} \n \
svn://.*/.*      ${TI_MIRROR} \n \
"

# SDK paths and names
SDK_NAME_PREFIX = "arago"
SDK_VERSION = "${DISTRO_VERSION}"
SDK_VENDOR = "-${SDK_NAME_PREFIX}"
SDK_NAME = "${SDK_NAME_PREFIX}-${SDK_VERSION}"
SDKPATHINSTALL = "/opt/${SDK_NAME}"

IMAGE_FSTYPES += "tar.xz.md5sum"

# Extra boot files for WIC images
do_image_wic[depends] += "tisdk-uenv:do_deploy"
IMAGE_BOOT_FILES += "uEnv.txt"

# Mask any broken recipes (currently none)
#BBMASK = ""

TCMODEAPPEND ?= "-${TCMODE}"
TMPDIR .= "${TCMODEAPPEND}"

# Start with default set of distro features
DISTRO_FEATURES = "${DISTRO_FEATURES_DEFAULT} ${DISTRO_FEATURES_LIBC}"

# Add additional distro features
DISTRO_FEATURES:append = " pam wayland opengl"
DISTRO_FEATURES:remove = "x11"
DISTRO_FEATURES:append = " opencl"
DISTRO_FEATURES:append = " vulkan"

# Normally target distro features will not be applied to native builds:
# Native distro features on this list will use the target feature value
DISTRO_FEATURES_FILTER_NATIVE:append = " opencl"
DISTRO_FEATURES_FILTER_NATIVESDK:append = " opencl"

# Set global runtime providers for major components
ARAGO_SYSVINIT ??= "0"
INIT_MANAGER ?= "${@['systemd','sysvinit'][int(d.getVar('ARAGO_SYSVINIT'))]}"

# Distro-specific package configuration
PACKAGECONFIG:append:pn-systemd = " coredump networkd resolved serial-getty-generator"

# Prefer OpenSSL over GnuTLS for curl due to TSU exemptions
PACKAGECONFIG:pn-curl = "${@bb.utils.contains("DISTRO_FEATURES", "ipv6", "ipv6", "", d)} proxy openssl verbose zlib"

PACKAGECONFIG:pn-glmark2 = "drm-gles2 wayland-gles2"

# Set this to empty string to prevent xwayland config from being added
PACKAGECONFIG:pn-weston-init = ""

# Enable testing for opencl and vulkan with piglit
PACKAGECONFIG:append:pn-piglit = " \
    ${@bb.utils.filter("DISTRO_FEATURES", "opencl vulkan", d)} \
    ${@bb.utils.contains("DISTRO_FEATURES", "opengl", "deqp-gles", "", d)} \
    ${@bb.utils.contains("DISTRO_FEATURES", "vulkan", "deqp-vk", "", d)} \
"
PACKAGECONFIG:pn-opengl-es-cts = "${@bb.utils.contains("DISTRO_FEATURES", "wayland", "wayland", "surfaceless", d)}"
PACKAGECONFIG:pn-vulkan-cts = "${@bb.utils.contains("DISTRO_FEATURES", "wayland", "wayland", "surfaceless", d)}"

# Use llvmpipe for better performance with software rendering
# Only available for armv6+ devices
MESA_GALLIUM_LLVM_PACKAGECONFIG = "gallium-llvm"
MESA_GALLIUM_LLVM_PACKAGECONFIG:omapl138 = ""
PACKAGECONFIG:append:pn-mesa = " ${MESA_GALLIUM_LLVM_PACKAGECONFIG}"
PACKAGECONFIG:append:pn-mesa-pvr = " ${MESA_GALLIUM_LLVM_PACKAGECONFIG}"

# Enable netperf intervals/pacing and histogram
PACKAGECONFIG:append:pn-netperf = " intervals histogram"

# Use OpenGL ES2 for SDL2
PACKAGECONFIG_GL:pn-libsdl2 = "gles2"

# Add KMS/DRM backend support
PACKAGECONFIG:append:pn-libsdl2 = " kmsdrm"

# Enable cryptodev/devcrypto engine in OpenSSL 1.1
PACKAGECONFIG:append:pn-openssl = " cryptodev-linux"

# Enable GST_TRACER logging in gstreamer
PACKAGECONFIG:append:pn-gstreamer1.0 = " tracer-hooks coretracers"

# Enable GBM in gstreamer
PACKAGECONFIG:append:pn-gstreamer1.0-plugins-base = " gbm"

# Enable kmssink in gstreamer
PACKAGECONFIG:append:pn-gstreamer1.0-plugins-bad = " kms"

# Enable gstreamer plugin for libcamera
PACKAGECONFIG:append:pn-libcamera = " gst"

# Disable pulseaudio routing in alsa by default
PACKAGECONFIG:remove:pn-alsa-plugins = "pulseaudio"
RDEPENDS:pulseaudio-server:remove = "alsa-plugins-pulseaudio-conf"

# Enable gstreamer based video for kmscube
PACKAGECONFIG:append:pn-kmscube = " gstreamer"

# Configure RAMFS for jailhouse linux-demo
JH_RAMFS_IMAGE = "tisdk-jailhouse-inmate"

# Enable UI and scripting for perf
PERF_FEATURES_ENABLE ?= "perf-scripting perf-tui"

ARAGO_KERNEL_SUFFIX ?= ""
ARAGO_IMAGE_SUFFIX ?= ""

# Set real-time kernel suffix
ARAGO_RT_ENABLE ?= "0"
ARAGO_KERNEL_SUFFIX:append = "${@oe.utils.conditional("ARAGO_RT_ENABLE", "1", "-rt", "", d)}"
ARAGO_IMAGE_SUFFIX:append = "${@oe.utils.conditional("ARAGO_RT_ENABLE", "1", "-rt", "", d)}"

# Load default preferences
require conf/distro/include/arago-prefs.inc

# Allow branding on top of Arago Distro and Core TI-SDK
# If ARAGO_BRAND is not set in local.conf, default to core
ARAGO_BRAND ??= "core"

require conf/distro/include/branding-${ARAGO_BRAND}.inc

# Disable meta-virtualization sanity check and warning
SKIP_META_VIRT_SANITY_CHECK = "1"

# Codecs in libav and ffmpeg with questionable patent statuses are not
# included by default. If you enable any of those codecs you should check
# if the below acceptance flags still work for your software distribution
LICENSE_FLAGS_ACCEPTED = "commercial_ffmpeg commercial_gstreamer1.0-libav"

# Temporary hack to fix a compile issue on Armv7 platforms with qtbase.
# We are working to reproduce this error and submit bug reports for this
# issue.
DEFAULTTUNE:armv7a = "armv7athf"
```

## meta-arago-distro/conf/distro/include/arago-prefs.inc
```bitbake
PREFERRED_PROVIDER_virtual/gettext = "gettext"

PREFERRED_PROVIDER_virtual/kernel:append = "${ARAGO_KERNEL_SUFFIX}"

PREFERRED_RPROVIDER_libnss-mdns = "avahi-libnss-mdns"

VIRTUAL-RUNTIME_dbus = "dbus-broker"

# Setting PREFERRED_VERSIONS due to selecting a specific version of a library or
# application that does not have a GPLv3 license
PREFERRED_VERSION_crda = "3.18"
PREFERRED_VERSION_obex = "0.34"

# Bump mesa-demos to include some patches not in a tagged release
PREFERRED_VERSION_mesa-demos = "9.0.0+git"
```

## meta-arago-distro/conf/distro/include/branding-core.inc
```bitbake
# Set extra preferences based on the product branding (AM-SDK, MC-SDK, etc)
# Examples could be different PREFERRED_PROVIDER or PREFERRED_VERSION
# As well as some other configurable aspects or variables
# Please avoid creating multiple versions of the same brand, if possible
# The policy is for the "Core" brand to be the default,
# hence this file is mostly empty and used as a template

# Raise priority for sample IPC FW images
ALTERNATIVE_PRIORITY:pn-ti-ipc-rtos = "15"

# GC320 support requires out-of-tree drivers not available in until LTS prep is
# complete. Disable for now.
# Remove gc320 - the driver fails to build with gcc12
MACHINE_FEATURES:remove = "gc320"
```

## meta-arago-distro/conf/layer.conf
```bitbake
# We have a conf and classes directory, append to BBPATH
BBPATH .= ":${LAYERDIR}"

# We have a recipes directory, add to BBFILES
BBFILES += "${LAYERDIR}/recipes*/*/*.bb ${LAYERDIR}/recipes*/*/*.bbappend"

BBFILE_COLLECTIONS += "meta-arago-distro"
BBFILE_PATTERN_meta-arago-distro := "^${LAYERDIR}/"
BBFILE_PRIORITY_meta-arago-distro = "10"

LAYERSERIES_COMPAT_meta-arago-distro = "walnascar whinlatter"

LAYERDEPENDS_meta-arago-distro = " \
    core \
    meta-ti-bsp \
    meta-ti-extras \
    openembedded-layer \
    networking-layer \
    multimedia-layer \
    meta-python \
    virtualization-layer \
    meta-arago-extras \
    meta-arago-test \
"

LAYERRECOMMENDS_meta-arago-distro = " \
    chromium-browser-layer \
    selinux \
"

BBFILES_DYNAMIC += " \
    chromium-browser-layer:${LAYERDIR}/dynamic-layers/chromium-browser-layer/recipes*/*/*.bbappend \
    selinux:${LAYERDIR}/dynamic-layers/selinux/recipes*/*/*.bbappend \
"

SIGGEN_EXCLUDE_SAFE_RECIPE_DEPS += " \
    weston-init->weston \
    weston-init->kbd \
"

HOSTTOOLS_NONFATAL += "corkscrew getent socket"
```

## meta-arago-extras/conf/layer.conf
```bitbake
# We have a conf and classes directory, append to BBPATH
BBPATH .= ":${LAYERDIR}"

# We have a recipes directory, add to BBFILES
BBFILES += "${LAYERDIR}/recipes*/*/*.bb ${LAYERDIR}/recipes*/*/*.bbappend"

BBFILE_COLLECTIONS += "meta-arago-extras"
BBFILE_PATTERN_meta-arago-extras := "^${LAYERDIR}/"
BBFILE_PRIORITY_meta-arago-extras = "10"

LAYERSERIES_COMPAT_meta-arago-extras = "walnascar whinlatter"

# Set a variable to get to the top of the metadata location
ARAGOBASE := '${@os.path.normpath("${LAYERDIR}/../")}'

LICENSE_PATH += "${LAYERDIR}/licenses"

LAYERDEPENDS_meta-arago-extras = " \
    core \
    meta-ti-bsp \
    meta-ti-extras \
    networking-layer \
    openembedded-layer \
"

BBFILES_DYNAMIC += " \
    qt6-layer:${LAYERDIR}/dynamic-layers/qt6-layer/recipes*/*/*.bbappend \
"
```

## meta-arago-test/conf/layer.conf
```bitbake
# We have a conf and classes directory, append to BBPATH
BBPATH .= ":${LAYERDIR}"

# We have a recipes directory, add to BBFILES
BBFILES += "${LAYERDIR}/recipes*/*/*.bb ${LAYERDIR}/recipes*/*/*.bbappend"

BBFILE_COLLECTIONS += "meta-arago-test"
BBFILE_PATTERN_meta-arago-test := "^${LAYERDIR}/"
BBFILE_PRIORITY_meta-arago-test = "10"

LAYERSERIES_COMPAT_meta-arago-test = "walnascar whinlatter"

# Set a variable to get to the top of the metadata location
TITESTBASE := '${@os.path.normpath("${LAYERDIR}/")}'

LICENSE_PATH += "${LAYERDIR}/licenses"

LAYERDEPENDS_meta-arago-test = " \
    core \
    openembedded-layer \
    networking-layer \
    filesystems-layer \
    meta-python \
"

BBFILES_DYNAMIC += " \
    qt6-layer:${LAYERDIR}/dynamic-layers/qt6-layer/recipes*/*/*.bbappend \
"
```
